## boards/shields/skeletyl/Kconfig.defconfig
```kconfig
if SHIELD_SKELETYL_DONGLE

config ZMK_KEYBOARD_NAME
    default "Skeletyl"

config ZMK_SPLIT_ROLE_CENTRAL
    default y
endif

if SHIELD_SKELETYL_LEFT || SHIELD_SKELETYL_RIGHT || SHIELD_SKELETYL_DONGLE

config ZMK_SPLIT
    default y

endif
```
