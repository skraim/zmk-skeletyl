#include "skeletyl.dtsi"

/ {
    chosen {
        zmk,kscan = &kscan;
    };

    kscan: kscan {
        compatible = "zmk,kscan-gpio-matrix";
        diode-direction = "col2row";
        wakeup-source;

        row-gpios = <&pro_micro 2 (GPIO_ACTIVE_HIGH | GPIO_PULL_DOWN)>,
                    <&pro_micro 3 (GPIO_ACTIVE_HIGH | GPIO_PULL_DOWN)>,
                    <&pro_micro 4 (GPIO_ACTIVE_HIGH | GPIO_PULL_DOWN)>,
                    <&pro_micro 5 (GPIO_ACTIVE_HIGH | GPIO_PULL_DOWN)>;

        col-gpios = <&pro_micro 15 GPIO_ACTIVE_HIGH>,
                    <&pro_micro 18 GPIO_ACTIVE_HIGH>,
                    <&pro_micro 14 GPIO_ACTIVE_HIGH>,
                    <&pro_micro 20 GPIO_ACTIVE_HIGH>,
                    <&pro_micro 21 GPIO_ACTIVE_HIGH>;
    };
};

&transform {
    col-offset = <5>;
};
